/* source key position labels */
#include "zmk-helpers/key-labels/glove80.h"

/* map the Glove's extra keys */
#define X_LT  \
                &none    &none &none &none &none                 &none &none &none &none &none \
                &none &none &none &none &none &none   &none &none &none &none &none &none \
                &none
#define X_RT    &none

#define X_LM    &none
#define X_RM    &none

#define X_LB    &none
#define X_MB    &none &none &none       &none &none &none
#define X_RB    &none

#define X_LH    &none &none &none &none &none
#define X_MH    &none &none
#define X_RH    &none &none &none &none &none

/* activate bluetooth */
#define CONFIG_WIRELESS

/* source the main keymap */
#include "base.keymap"

